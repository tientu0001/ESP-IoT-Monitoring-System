

#include "config.h"
#include "Fun_nfc.h"

#include "Fun_time.h"
#include "Fun_wifi.h"
#include "Fun_mqtt.h"
#include "Fun_e2p.h"
#include "Fun_operation.h"

#include "Ui_lcd.h"

/////////////////////////////////////////////////////////////////////////////////////
#define NFC_RST 2
#define NFC_SS 15

#include <MFRC522.h>
MFRC522 mfrc522(NFC_SS, NFC_RST); // Create MFRC522 instance
/////////////////////////////////////////////////////////////////////////////////////
#define NR_KNOWN_KEYS 5
byte knownKeys[NR_KNOWN_KEYS][MFRC522::MF_KEY_SIZE] = {
    {0xFF, 0xFF, 0xFF, 0xFF, 0xFF, 0xFF}, // FF FF FF FF FF FF = factory default
    {0xD3, 0xD7, 0xD3, 0xD7, 0xD3, 0xD7}, // D3 D7 D3 D7 D3 D7
    {0xA0, 0xA1, 0xA2, 0xA3, 0xA4, 0xA5}, // A0 A1 A2 A3 A4 A5
    {0xAA, 0xBB, 0xCC, 0xDD, 0xEE, 0xFF}, // AA BB CC DD EE FF
    {0x00, 0x00, 0x00, 0x00, 0x00, 0x00}  // 00 00 00 00 00 00
};
/////////////////////////////////////////////////////////////////////////////////////
#define INTERVAL_SCAN_NFC 200 // ms

#define NFC_TAG_COMM_ERROR 0x00
#define NFC_TAG_COMM_SUCCESS 0x01

#define TAG_ID_M1K 0x10
#define TAG_ID_UL 0x20
#define TAG_ID_PLX 0x30

MFRC522::StatusCode RfidSts;
MFRC522::PICC_Type RfidPicc;

// position increase - dynamic
uint8_t ucNfcComErr;
/////////////////////////////////////////////////////////////////////////////////////
Fun_nfc nfc;
/////////////////////////////////////////////////////////////////////////////////////
static MFRC522::StatusCode authenNfc1K(byte bBlock)
{
    MFRC522::StatusCode StsCode;
    MFRC522::MIFARE_Key key;

    // authen with key B
    for (int k = 0; k < NR_KNOWN_KEYS; k++)
    {
        for (int i = 0; i < 6; i++)
            key.keyByte[i] = knownKeys[k][i];
        StsCode = mfrc522.PCD_Authenticate(MFRC522::PICC_CMD_MF_AUTH_KEY_B, bBlock, &key, &(mfrc522.uid)); // line 834 of MFRC522.cpp file
        if (StsCode == MFRC522::STATUS_OK)
            return StsCode;
    }

    return StsCode;
}
/////////////////////////////////////////////////////////////////////////////////////
MFRC522::PICC_Type rfid_CheckTag()
{
    // if (!mfrc522.PICC_IsNewCardPresent())
    //     return (0);
    // if (!mfrc522.PICC_ReadCardSerial())
    //     return (0);

    return mfrc522.PICC_GetType(mfrc522.uid.sak);

    // RfidPicc = mfrc522.PICC_GetType(mfrc522.uid.sak);

    // switch (RfidPicc)
    // {
    // case MFRC522::PICC_TYPE_MIFARE_UL:
    //     return (TAG_ID_UL); // ultralight
    // case MFRC522::PICC_TYPE_MIFARE_1K:
    //     return (TAG_ID_M1K); // classic 1k
    // case MFRC522::PICC_TYPE_ISO_14443_4:
    //     return (TAG_ID_PLX); // plus X 2k
    // default:
    // {
    //     sTitle = "NFC Check";
    //     pcDispChar = (char *)"Wrong TAG";

    //     return (MFRC522::PICC_TYPE_UNKNOWN);
    // }
    // }

    // return (0);
}
/////////////////////////////////////////////////////////////////////////////////////
Fun_nfc::Fun_nfc()
{
}

/////////////////////////////////////////////////////////////////////////////////////
Fun_nfc::~Fun_nfc()
{
}
/////////////////////////////////////////////////////////////////////////////////////
void Fun_nfc::init()
{
    SPI.begin();                                                   // Init SPI bus
    mfrc522.PCD_Init();                                            // Init MFRC522
    mfrc522.PCD_SetRegisterBitMask(mfrc522.RFCfgReg, (0x07 << 4)); // Enhance the MFRC522 Receiver Gain to maximum value of some 48 dB
}
/////////////////////////////////////////////////////////////////////////////////////
void Fun_nfc::loop()
{
    if ((millis() - ulMillis < INTERVAL_SCAN_NFC))
        return;

    if (!mfrc522.PICC_IsNewCardPresent())
        return;
    if (!mfrc522.PICC_ReadCardSerial())
        return;

    // ucTypeNfcTag = rfid_CheckTag();
    // if (ucTypeNfcTag == MFRC522::PICC_TYPE_UNKNOWN)
    // {
    //     debug.msg_debug.concat(" --/ get_nfc_tag, fail:");
    //     debug.msg_debug.concat(" --/ ucTypeNfcTag:");
    //     debug.msg_debug.concat((uint8_t)ucTypeNfcTag);
    //     debug.send_debug = true;

    //     nfc.bHanldeSuccess = false;
    //     active_led_nfc_fail();

    //     ulMillis = millis();
    //     return;
    // }

    uint8_t ucTypeNfcTag = (uint8_t)mfrc522.PICC_GetType(mfrc522.uid.sak);
    sUid = getUidNfcTag_reverse(); // get Uid nfc tag reverse

#ifdef ESP_DEBUG_NFC
    Serial.printf("nfc_loop: sUid: %s, ucTypeNfcTag: %d\r\n", sUid.c_str(), ucTypeNfcTag);
#endif

    debug.msg_debug.concat(" --/ get_nfc_tag, sUid:");
    debug.msg_debug.concat(sUid);
    debug.msg_debug.concat(" --/ ucTypeNfcTag:");
    debug.msg_debug.concat((uint8_t)ucTypeNfcTag);
    debug.send_debug = true;

    ucLenUidBlank = 11;

    switch (ucTypeNfcTag)
    {
    case (uint8_t)MFRC522::PICC_TYPE_MIFARE_UL:
        ucLenUidBlank = 20;
        ckTAG_ID_UL();
        break;
    case (uint8_t)MFRC522::PICC_TYPE_MIFARE_1K:
        ckTAG_ID_M1K();
        break;
    default:
        ckTAG_ID_PLX();
        break;
    }

    // switch (ucTypeNfcTag)
    // {
    // case TAG_ID_UL:
    //     ckTAG_ID_UL();
    //     break;
    // case TAG_ID_M1K:
    //     ckTAG_ID_M1K();
    //     break;
    // case TAG_ID_PLX:
    //     ckTAG_ID_PLX();
    //     break;
    // default:
    //     break;
    // }

    // Finalize
    mfrc522.PICC_HaltA();
    mfrc522.PCD_StopCrypto1();

    ulMillis = millis();
}
/////////////////////////////////////////////////////////////////////////////////////
String Fun_nfc::getUidNfcTag_reverse()
{
    String sWrkUid = "";
    String s;
    uint8_t ucIndx = 0;

    for (int i = mfrc522.uid.size - 1; i >= 0; i--)
    {
        ucUidBlank[ucIndx++] = mfrc522.uid.uidByte[i]; // add for save byte uid to E2P when detect blank nfc

        uint8_t ucUid = mfrc522.uid.uidByte[i];
        s = String(ucUid, HEX);
        if (s.length() == 1)
            s = '0' + s;
        sWrkUid += s;

        if (i != 0)
            sWrkUid += String(":");
    }

    sWrkUid.toUpperCase();
    return sWrkUid;
}
/////////////////////////////////////////////////////////////////////////////////////
void Fun_nfc::ckTAG_ID_UL()
{
    // Write mode
    if (ucMode == RFID_MOD_WRITE)
    {
        if (rfid_WriteTagData_ult() == NFC_TAG_COMM_ERROR)
        {
            ucMode = RFID_MOD_READ;

            nfc.bHanldeSuccess = false;
            active_led_nfc_fail();
        }
        else
        {
            nfc.bHanldeSuccess = true;
            active_led_nfc_success();
        }
    }
    // Read mode
    else if (ucMode == RFID_MOD_READ)
    {
        ucReadType = rfid_ReadTagData_ult(); // for show data when tag successed
        if (ucReadType == NFC_TAG_COMM_ERROR)
        {
            nfc.bHanldeSuccess = false;
            lcd.disp_nfc_tag_handle();
            active_led_nfc_fail();
        }
        else
        {
            if (ucReadType == NFC_TAG_TYPE_BLANK)
                handle_nfc_blank();

            lcd.disp_nfc_tag_read();
            active_led_nfc_success();
        }
    }
}
/////////////////////////////////////////////////////////////////////////////////////
void Fun_nfc::ckTAG_ID_M1K()
{
    // Write mode
    if (ucMode == RFID_MOD_WRITE)
    {
        if (rfid_WriteTagData_m1k() == NFC_TAG_COMM_ERROR)
        {
            ucMode = RFID_MOD_READ;

            nfc.bHanldeSuccess = false;
            active_led_nfc_fail();
        }
        else
        {
#ifdef ESP_DEBUG_NFC
            Serial.printf("nfc_ckTAG_ID_M1K, write success\r\n");
#endif

            nfc.bHanldeSuccess = true;
            active_led_nfc_success();
        }

        lcd.disp_nfc_tag_handle();
    }
    // Read mode
    else if (ucMode == RFID_MOD_READ)
    {
        ucReadType = rfid_ReadTagData_m1k(); // for show data when tag successed
        if (ucReadType == NFC_TAG_COMM_ERROR)
        {
            nfc.bHanldeSuccess = false;
            lcd.disp_nfc_tag_handle();
            active_led_nfc_fail();
        }
        else
        {
            if (ucReadType == NFC_TAG_TYPE_BLANK)
                handle_nfc_blank();

            lcd.disp_nfc_tag_read();
            active_led_nfc_success();
        }
    }
}
/////////////////////////////////////////////////////////////////////////////////////
void Fun_nfc::ckTAG_ID_PLX()
{
    if (ucMode == RFID_MOD_READ)
    {
        handle_nfc_blank();
        ucReadType = NFC_TAG_TYPE_BLANK;

        lcd.disp_nfc_tag_read();
        active_led_nfc_success();
    }
}
/////////////////////////////////////////////////////////////////////////////////////
void Fun_nfc::handle_nfc_blank()
{
#ifdef ESP_DEBUG_NFC
    Serial.printf("nfc_ckTAG_ID_M1K: NFC_TAG_TYPE_BLANK\r\n");
#endif

    // if (ucTypeNfcTag == TAG_ID_PLX || ucTypeNfcTag == TAG_ID_M1K)
    // {
    //     // uid: CD:1D:6C:5B : len = 11
    //     ucLenUidBlank = 11;
    // }
    // else if (ucTypeNfcTag == TAG_ID_UL)
    // {
    //     // uid: 80:6B:81:92:57:B0:04 : len = 20
    //     ucLenUidBlank = 20;
    // }
    // else
    // {
    //     ucLenUidBlank = 0;
    // }

    sUidBlank = sUid;

    e2p_info.write(E2PE_ADR_LEN_BLA_NFC, ucLenUidBlank);
    e2p_info.StringToE2P(E2PE_ADR_NFC_UID_STR, ucLenUidBlank, sUidBlank);
    e2p_info.commit_flag = true;

    debug.msg_debug.concat(" --/ write_nfc_uid, ");
    debug.msg_debug.concat("len: ");
    debug.msg_debug.concat(nfc.ucLenUidBlank);
    debug.msg_debug.concat(", ");
    debug.msg_debug.concat("uid: ");
    debug.msg_debug.concat(nfc.sUidBlank);
    debug.msg_debug.concat("/");
    debug.msg_debug.concat(e2p_info.E2PtoString(E2PE_ADR_NFC_UID_STR, nfc.ucLenUidBlank));
    debug.send_debug = true;

    if (!oper.in_out_iot_mode_enable)
    {
        // sUidBlank = sUid;

        if (WiFi.status() == WL_CONNECTED)
        {
            bSendUidWithWifiConnected = 1;
            return;
        }

        bSendUidNfcBlank2Svr = true;
        e2p_info.write(E2PE_ADR_SEN_BLA_NFC, 1);
        e2p_info.commit_flag = true;
    }
    else
    {
        if (oper.bGetDatetime)
        {
            ti.getSysTime();
            inOut_mode.hour[inOut_mode.qFont] = ti.sysTime.tm_hour;
            inOut_mode.min[inOut_mode.qFont] = ti.sysTime.tm_min;
            inOut_mode.sec[inOut_mode.qFont] = ti.sysTime.tm_sec;

            inOut_mode.get_date_time[inOut_mode.qFont] = true;
        }
        else
        {
            inOut_mode.get_date_time[inOut_mode.qFont] = false;
        }

        inOut_mode.u8_inout_input_mode[inOut_mode.qFont] = oper.in_out_input_mode;

        inOut_mode.uid[inOut_mode.qFont] = sUid;

        inOut_mode.qFont = (inOut_mode.qFont + 1) % INOUT_Q_LEN_BUFF;
    }
}
/////////////////////////////////////////////////////////////////////////////////////
uint8_t Fun_nfc::rfid_WriteTagData_ult()
{
    uint8_t i, j, ucBufTmp[18];
    uint8_t bPageAddr, bPageCnt;
    uint8_t ucTypeTagWrite;

    memset(ucDataBuf, 0x00, RFID_DATA_LEN);

    ucTypeTagWrite = ucWriteType;
    switch (ucWriteType)
    {
    case RFID_TAG_TYPE_NETWORK:
    {
        NFC_WRITE_TYPE_NETWORK();
        bPageCnt = RFID_PGE_END_NETWORK_ULT;
        break;
    }
    case RFID_TAG_TYPE_OUTPUT:
    {
        NFC_WRITE_TYPE_OUTPUT();
        bPageCnt = RFID_PGE_END_OUTPUT_ULT;
        break;
    }
    default:
        return NFC_TAG_COMM_ERROR;
    }

    // Write type to TAG
    bPageAddr = RFID_TAG_TYPE_INFO_PGE;
    ucBufTmp[0] = ucTypeTagWrite;
    ucBufTmp[1] = 0;
    ucBufTmp[2] = 0;
    ucBufTmp[3] = 0;
    RfidSts = (MFRC522::StatusCode)mfrc522.MIFARE_Write(bPageAddr++, ucBufTmp, 16);
    if (RfidSts != MFRC522::STATUS_OK)
        return (NFC_TAG_COMM_ERROR);

    // Write data to TAG
    j = 0;
    while (1)
    {
        for (i = 0; i < 4; i++)
            ucBufTmp[i] = ucDataBuf[(4 * j) + i];
        RfidSts = (MFRC522::StatusCode)mfrc522.MIFARE_Write(bPageAddr++, ucBufTmp, 16); // each time write 4 bytes(1 page addr) to nfc tag
        if (RfidSts != MFRC522::STATUS_OK)
            return (NFC_TAG_COMM_ERROR);

        j++;
        if (bPageAddr >= bPageCnt)
            break;
    }

    return (NFC_TAG_COMM_SUCCESS);
}
/////////////////////////////////////////////////////////////////////////////////////
uint8_t Fun_nfc::rfid_ReadTagData_ult()
{
    uint8_t ucTagType, i, j;
    uint8_t ucBufTmp[18];
    byte bPageAddr, bPageCnt;
    byte size = sizeof(ucBufTmp); // This library baced on Mifare classic(must use 18byte)

    memset(ucDataBuf, 0x00, RFID_DATA_LEN);

    // Check Type
    bPageAddr = RFID_TAG_TYPE_INFO_PGE;
    RfidSts = (MFRC522::StatusCode)mfrc522.MIFARE_Read(bPageAddr++, ucBufTmp, &size);
    if (RfidSts == MFRC522::STATUS_OK)
        ucTagType = ucBufTmp[0];
    else
        return NFC_TAG_COMM_ERROR;

    ucReadType = ucTagType & 0x0F; // for show data when tag successed

    switch (ucTagType & 0x0F)
    {

    case RFID_TAG_TYPE_NETWORK:
    {
        bPageCnt = RFID_PGE_END_NETWORK_ULT;
        break;
    }
    case RFID_TAG_TYPE_OUTPUT:
    {
        bPageCnt = RFID_PGE_END_OUTPUT_ULT;
        break;
    }
    default:
    {
        return NFC_TAG_TYPE_BLANK;
    }
    }

    // Read Nfc
    j = 0;
    while (1)
    {
        RfidSts = (MFRC522::StatusCode)mfrc522.MIFARE_Read(bPageAddr++, ucBufTmp, &size);
        for (i = 0; i < 4; i++)
            ucDataBuf[(4 * j) + i] = ucBufTmp[i];
        j++;
        if (RfidSts != MFRC522::STATUS_OK)
            return NFC_TAG_COMM_ERROR;
        if (bPageAddr >= bPageCnt)
            break;
    }

    // Action depends on Tag type
    switch (ucTagType & 0x0F)
    {
    case RFID_TAG_TYPE_NETWORK:
    {
        NFC_READ_TYPE_NETWORK();
        return NFC_TAG_TYPE_NETWORK;
    }
    case RFID_TAG_TYPE_OUTPUT:
    {
        FUN_NFC_READ_OUTPUT();
        return NFC_TAG_TYPE_OUTPUT;
    }
    default:
        break;
    }

    return NFC_TAG_COMM_ERROR;
}
/////////////////////////////////////////////////////////////////////////////////////
uint8_t Fun_nfc::rfid_WriteTagData_m1k()
{
    uint8_t ucBufTmp[18];
    byte bPageCnt, block;
    uint8_t ucTypeTagWrite;

    sTitle = "NFC Write";
    pcDispChar = (char *)"  (Write)";

    memset(ucDataBuf, 0x00, RFID_DATA_LEN);

    ucTypeTagWrite = ucWriteType;
    switch (ucWriteType)
    {
    case RFID_TAG_TYPE_NETWORK:
    {
#ifdef ESP_DEBUG_NFC
        Serial.printf("nfc_rfid_WriteTagData_m1k: NFC_WRITE_TYPE_NETWORK\r\n");
#endif
        NFC_WRITE_TYPE_NETWORK();
        bPageCnt = RFID_PGE_END_NETWORK_M1K;
        break;
    }
    case RFID_TAG_TYPE_OUTPUT:
    {
        NFC_WRITE_TYPE_OUTPUT();
        bPageCnt = RFID_PGE_END_OUTPUT_M1K;
        break;
    }
    case RFID_TAG_TYPE_EARSE:
    {
        bPageCnt = RFID_PGE_END_EARSE_M1K;
        break;
    }
    default:
        return NFC_TAG_COMM_ERROR;
    }

    block = 4;

    //    RfidSts = (MFRC522::StatusCode) mfrc522.PCD_Authenticate( MFRC522::PICC_CMD_MF_AUTH_KEY_A, block, &key, &(mfrc522.uid) );
    RfidSts = authenNfc1K(block);
    if (RfidSts != MFRC522::STATUS_OK)
    {
        pcDispChar = (char *)"  Fail Key";
        return NFC_TAG_COMM_ERROR;
    }

    // Write type to TAG
    ucBufTmp[0] = ucTypeTagWrite;
    for (uint8_t bf = 1; bf < 16; bf++)
        ucBufTmp[bf] = 0x00;
    RfidSts = (MFRC522::StatusCode)mfrc522.MIFARE_Write(block, ucBufTmp, 16);
    if (RfidSts != MFRC522::STATUS_OK)
        return NFC_TAG_COMM_ERROR;

    // Write data to TAG.. begin with block 5
    uint8_t blockzero = 5;
    uint8_t po = 0;

    for (byte block = blockzero; block < blockzero + bPageCnt; block++)
    {
        //  without get Block 0;3;7;11;15...
        if ((block == 7) || (block == 11) || (block == 15))
            continue;

        //    RfidSts = (MFRC522::StatusCode) mfrc522.PCD_Authenticate( MFRC522::PICC_CMD_MF_AUTH_KEY_A, block, &key, &(mfrc522.uid) );
        RfidSts = authenNfc1K(block);
        if (RfidSts != MFRC522::STATUS_OK)
        {
            pcDispChar = (char *)"  Fail Key";
            return NFC_TAG_COMM_ERROR;
        }

        // Write block
        RfidSts = (MFRC522::StatusCode)mfrc522.MIFARE_Write(block, &ucDataBuf[po * 16], 16);
        if (RfidSts != MFRC522::STATUS_OK)
            return NFC_TAG_COMM_ERROR;

        po++;
    }

    return NFC_TAG_COMM_SUCCESS;
}
/////////////////////////////////////////////////////////////////////////////////////
uint8_t Fun_nfc::rfid_ReadTagData_m1k()
{
    byte block;
    byte len;
    uint8_t ucTagType;
    uint8_t ucBufTmp[18];
    byte bPageCnt;

    sTitle = "NFC Read";
    pcDispChar = (char *)"   (Read)";

    memset(ucDataBuf, 0x00, RFID_DATA_LEN);

    //--- GET Typer NFC tag
    block = 4;
    len = 18;

    //    RfidSts = (MFRC522::StatusCode) mfrc522.PCD_Authenticate( MFRC522::PICC_CMD_MF_AUTH_KEY_A, block, &key, &(mfrc522.uid) );
    RfidSts = authenNfc1K(block);
    if (RfidSts != MFRC522::STATUS_OK)
    {
        pcDispChar = (char *)"  Fail Key";
        return NFC_TAG_COMM_ERROR;
    }

    RfidSts = (MFRC522::StatusCode)mfrc522.MIFARE_Read(block, ucBufTmp, &len);
    if (RfidSts == MFRC522::STATUS_OK)
        ucTagType = ucBufTmp[0];
    else
        return NFC_TAG_COMM_ERROR;

    switch (ucTagType & 0x0F)
    {
    case RFID_TAG_TYPE_NETWORK:
    {
        bPageCnt = RFID_PGE_END_NETWORK_M1K;
        break;
    }
    case RFID_TAG_TYPE_OUTPUT:
    {
        bPageCnt = RFID_PGE_END_OUTPUT_M1K;
        break;
    }
    default:
    {
        return NFC_TAG_TYPE_BLANK;
    }
    }

    byte blockzero = 5;
    uint8_t po = 0;

    for (byte block = blockzero; block < blockzero + bPageCnt; block++)
    {
        //  without get Block 0;3;7;11;15...
        if ((block == 7) || (block == 11) || (block == 15))
            continue;

        if (block == 8 || block == 12) // new sector, need to authen
        {
            //    RfidSts = (MFRC522::StatusCode) mfrc522.PCD_Authenticate( MFRC522::PICC_CMD_MF_AUTH_KEY_A, byte(block), &key, &(mfrc522.uid) );
            RfidSts = authenNfc1K(block);
            if (RfidSts != MFRC522::STATUS_OK)
            {
                pcDispChar = (char *)"  Fail Key";
                return NFC_TAG_COMM_ERROR;
            }
        }

        // Read block
        RfidSts = (MFRC522::StatusCode)mfrc522.MIFARE_Read(byte(block), &ucDataBuf[po * 16], &len);
        if (RfidSts != MFRC522::STATUS_OK)
            return NFC_TAG_COMM_ERROR;
        po++;
    }

    // Action depends on Tag type
    switch (ucTagType & 0x0F)
    {

    case RFID_TAG_TYPE_NETWORK:
    {
        NFC_READ_TYPE_NETWORK();
        return NFC_TAG_TYPE_NETWORK;
    }
    case RFID_TAG_TYPE_OUTPUT:
    {
        FUN_NFC_READ_OUTPUT();
        return NFC_TAG_TYPE_OUTPUT;
    }
    default:
        break;
    }

    return NFC_TAG_COMM_ERROR;
}
/////////////////////////////////////////////////////////////////////////////////////
void Fun_nfc::NFC_WRITE_TYPE_NETWORK()
{
    wifi.sSsid.toCharArray(ucSsid, E2PE_LEN_SSID + 1);
    wifi.sPassword.toCharArray(ucPassword, E2PE_LEN_PASS + 1);
    mqtt.sSvrAddr.toCharArray(ucSvrAddr, E2PE_LEN_SVR_ADDR + 1);

    int i, j;

    j = 0;
    for (i = j; i < j + E2PE_LEN_SSID; ++i)
        ucDataBuf[i] = ucSsid[i];
    j += E2PE_LEN_SSID;
    for (i = j; i < j + E2PE_LEN_PASS; ++i)
        ucDataBuf[i] = ucPassword[i - j];
    j += E2PE_LEN_PASS;
    for (i = j; i < j + E2PE_LEN_SVR_ADDR; ++i)
        ucDataBuf[i] = ucSvrAddr[i - j];
    j += E2PE_LEN_SVR_ADDR;
    ucDataBuf[i] = (uint8_t)(mqtt.usSvrPort >> 8);
    ucDataBuf[i + 1] = (uint8_t)mqtt.usSvrPort;
}
/////////////////////////////////////////////////////////////////////////////////////
void Fun_nfc::NFC_READ_TYPE_NETWORK()
{
    int i, j;

    j = 0;
    for (i = j; i < j + E2PE_LEN_SSID; ++i)
        ucSsid[i - j] = ucDataBuf[i]; // get ssid
    j += E2PE_LEN_SSID;
    for (i = j; i < j + E2PE_LEN_PASS; ++i)
        ucPassword[i - j] = ucDataBuf[i]; // get password
    j += E2PE_LEN_PASS;
    for (i = j; i < j + E2PE_LEN_SVR_ADDR; ++i)
        ucSvrAddr[i - j] = ucDataBuf[i]; // get svrAddr
    j += E2PE_LEN_SVR_ADDR;

    wifi.sSsid = String(ucSsid);
    wifi.sPassword = String(ucPassword);

    mqtt.sSvrAddr = String(ucSvrAddr);
    mqtt.usSvrPort = (uint16_t)ucDataBuf[i] << 8;
    mqtt.usSvrPort += (uint16_t)ucDataBuf[i + 1];

    e2p_network.StringToE2P(E2PE_ADR_SSID, E2PE_LEN_SSID, wifi.sSsid);
    e2p_network.StringToE2P(E2PE_ADR_PASS, E2PE_LEN_PASS, wifi.sPassword);
    e2p_network.StringToE2P(E2PE_ADR_SVR_ADDR, E2PE_LEN_SVR_ADDR, mqtt.sSvrAddr);
    e2p_network.write_16(E2PE_ADR_SVR_PORT, mqtt.usSvrPort);
    e2p_network.commit_flag = true;

#ifdef ESP_DEBUG_NFC
    Serial.printf("nfc_NFC_READ_TYPE_NETWORK\r\n");
    Serial.printf("\twifi.sSsid: %s\r\n", wifi.sSsid.c_str());
    Serial.printf("\twifi.sPassword: %s\r\n", wifi.sPassword.c_str());
    Serial.printf("\tmqtt.sSvrAddr: %s\r\n", mqtt.sSvrAddr.c_str());
    Serial.printf("\tmqtt.usSvrPort: %d\r\n", mqtt.usSvrPort);
#endif
}
/////////////////////////////////////////////////////////////////////////////////////
void Fun_nfc::NFC_WRITE_TYPE_OUTPUT()
{
    // reset data
    for (int i = 0; i < 4; i++)
        ucDataBuf[i] = 0x00;

    if (ucIncDecType == NFC_INCDEC_INCREASE)
    {
        ucDataBuf[0] = 0x02;
        ucDataBuf[2] = ucInDecScale;
    }
    else
    {
        ucDataBuf[1] = 0x02;
    }
}
/////////////////////////////////////////////////////////////////////////////////////
void Fun_nfc::FUN_NFC_READ_OUTPUT()
{
    for (int i = 0; i < 4; i++)
    {
        if (ucDataBuf[i] == 0x02 && i < 2)
        {
            if (i == 0) // Nfc increase output
            {
                if (ucDataBuf[i + 2] == 1)
                    oper.output = oper.output + 1;
                else
                    oper.output = oper.output + 5;

                oper.addQueue_product_data(Q_TYPE_OUTPUT, oper.output);

                lcd_refresh();
            }
            else // Nfc decrease output
            {
                if (oper.output)
                {
                    oper.output--;
                    oper.addQueue_product_data(Q_TYPE_OUTPUT, oper.output);

                    lcd_refresh();
                }
            }
        }
    }
}
/////////////////////////////////////////////////////////////////////////////////////

/////////////////////////////////////////////////////////////////////////////////////

/////////////////////////////////////////////////////////////////////////////////////

/////////////////////////////////////////////////////////////////////////////////////

/////////////////////////////////////////////////////////////////////////////////////

/////////////////////////////////////////////////////////////////////////////////////

/////////////////////////////////////////////////////////////////////////////////////

/////////////////////////////////////////////////////////////////////////////////////

/////////////////////////////////////////////////////////////////////////////////////

/////////////////////////////////////////////////////////////////////////////////////

/////////////////////////////////////////////////////////////////////////////////////

/////////////////////////////////////////////////////////////////////////////////////

/////////////////////////////////////////////////////////////////////////////////////

/////////////////////////////////////////////////////////////////////////////////////

/////////////////////////////////////////////////////////////////////////////////////

/////////////////////////////////////////////////////////////////////////////////////

/////////////////////////////////////////////////////////////////////////////////////

/////////////////////////////////////////////////////////////////////////////////////

/////////////////////////////////////////////////////////////////////////////////////

/////////////////////////////////////////////////////////////////////////////////////

/////////////////////////////////////////////////////////////////////////////////////

/////////////////////////////////////////////////////////////////////////////////////

/////////////////////////////////////////////////////////////////////////////////////

/////////////////////////////////////////////////////////////////////////////////////

/////////////////////////////////////////////////////////////////////////////////////

/////////////////////////////////////////////////////////////////////////////////////

/////////////////////////////////////////////////////////////////////////////////////

/////////////////////////////////////////////////////////////////////////////////////

/////////////////////////////////////////////////////////////////////////////////////

/////////////////////////////////////////////////////////////////////////////////////

/////////////////////////////////////////////////////////////////////////////////////

/////////////////////////////////////////////////////////////////////////////////////

/////////////////////////////////////////////////////////////////////////////////////

/////////////////////////////////////////////////////////////////////////////////////

/////////////////////////////////////////////////////////////////////////////////////

/////////////////////////////////////////////////////////////////////////////////////

/////////////////////////////////////////////////////////////////////////////////////

/////////////////////////////////////////////////////////////////////////////////////

/////////////////////////////////////////////////////////////////////////////////////

/////////////////////////////////////////////////////////////////////////////////////

/////////////////////////////////////////////////////////////////////////////////////

/////////////////////////////////////////////////////////////////////////////////////

/////////////////////////////////////////////////////////////////////////////////////

/////////////////////////////////////////////////////////////////////////////////////

/////////////////////////////////////////////////////////////////////////////////////

/////////////////////////////////////////////////////////////////////////////////////

/////////////////////////////////////////////////////////////////////////////////////

/////////////////////////////////////////////////////////////////////////////////////

/////////////////////////////////////////////////////////////////////////////////////

/////////////////////////////////////////////////////////////////////////////////////

/////////////////////////////////////////////////////////////////////////////////////

/////////////////////////////////////////////////////////////////////////////////////

/////////////////////////////////////////////////////////////////////////////////////

/////////////////////////////////////////////////////////////////////////////////////

/////////////////////////////////////////////////////////////////////////////////////

/////////////////////////////////////////////////////////////////////////////////////

/////////////////////////////////////////////////////////////////////////////////////

/////////////////////////////////////////////////////////////////////////////////////

/////////////////////////////////////////////////////////////////////////////////////

/////////////////////////////////////////////////////////////////////////////////////

/////////////////////////////////////////////////////////////////////////////////////

/////////////////////////////////////////////////////////////////////////////////////

/////////////////////////////////////////////////////////////////////////////////////

/////////////////////////////////////////////////////////////////////////////////////

/////////////////////////////////////////////////////////////////////////////////////

/////////////////////////////////////////////////////////////////////////////////////

/////////////////////////////////////////////////////////////////////////////////////

/////////////////////////////////////////////////////////////////////////////////////

/////////////////////////////////////////////////////////////////////////////////////

/////////////////////////////////////////////////////////////////////////////////////

/////////////////////////////////////////////////////////////////////////////////////

/////////////////////////////////////////////////////////////////////////////////////

/////////////////////////////////////////////////////////////////////////////////////

/////////////////////////////////////////////////////////////////////////////////////

/////////////////////////////////////////////////////////////////////////////////////

/////////////////////////////////////////////////////////////////////////////////////

/////////////////////////////////////////////////////////////////////////////////////

/////////////////////////////////////////////////////////////////////////////////////

/////////////////////////////////////////////////////////////////////////////////////

/////////////////////////////////////////////////////////////////////////////////////

/////////////////////////////////////////////////////////////////////////////////////

/////////////////////////////////////////////////////////////////////////////////////

/////////////////////////////////////////////////////////////////////////////////////

/////////////////////////////////////////////////////////////////////////////////////

/////////////////////////////////////////////////////////////////////////////////////

/////////////////////////////////////////////////////////////////////////////////////

/////////////////////////////////////////////////////////////////////////////////////

/////////////////////////////////////////////////////////////////////////////////////

/////////////////////////////////////////////////////////////////////////////////////

/////////////////////////////////////////////////////////////////////////////////////

/////////////////////////////////////////////////////////////////////////////////////

/////////////////////////////////////////////////////////////////////////////////////

/////////////////////////////////////////////////////////////////////////////////////

/////////////////////////////////////////////////////////////////////////////////////

/////////////////////////////////////////////////////////////////////////////////////

/////////////////////////////////////////////////////////////////////////////////////

/////////////////////////////////////////////////////////////////////////////////////

/////////////////////////////////////////////////////////////////////////////////////

/////////////////////////////////////////////////////////////////////////////////////

/////////////////////////////////////////////////////////////////////////////////////

/////////////////////////////////////////////////////////////////////////////////////

/////////////////////////////////////////////////////////////////////////////////////

/////////////////////////////////////////////////////////////////////////////////////

/////////////////////////////////////////////////////////////////////////////////////

/////////////////////////////////////////////////////////////////////////////////////

/////////////////////////////////////////////////////////////////////////////////////

/////////////////////////////////////////////////////////////////////////////////////

/////////////////////////////////////////////////////////////////////////////////////

/////////////////////////////////////////////////////////////////////////////////////

/////////////////////////////////////////////////////////////////////////////////////

/////////////////////////////////////////////////////////////////////////////////////

/////////////////////////////////////////////////////////////////////////////////////

/////////////////////////////////////////////////////////////////////////////////////

/////////////////////////////////////////////////////////////////////////////////////

/////////////////////////////////////////////////////////////////////////////////////

/////////////////////////////////////////////////////////////////////////////////////

/////////////////////////////////////////////////////////////////////////////////////

/////////////////////////////////////////////////////////////////////////////////////

/////////////////////////////////////////////////////////////////////////////////////

/////////////////////////////////////////////////////////////////////////////////////

/////////////////////////////////////////////////////////////////////////////////////

/////////////////////////////////////////////////////////////////////////////////////

/////////////////////////////////////////////////////////////////////////////////////

/////////////////////////////////////////////////////////////////////////////////////

/////////////////////////////////////////////////////////////////////////////////////

/////////////////////////////////////////////////////////////////////////////////////

/////////////////////////////////////////////////////////////////////////////////////

/////////////////////////////////////////////////////////////////////////////////////

/////////////////////////////////////////////////////////////////////////////////////

/////////////////////////////////////////////////////////////////////////////////////

/////////////////////////////////////////////////////////////////////////////////////

/////////////////////////////////////////////////////////////////////////////////////

/////////////////////////////////////////////////////////////////////////////////////

/////////////////////////////////////////////////////////////////////////////////////

/////////////////////////////////////////////////////////////////////////////////////

/////////////////////////////////////////////////////////////////////////////////////

/////////////////////////////////////////////////////////////////////////////////////

/////////////////////////////////////////////////////////////////////////////////////

/////////////////////////////////////////////////////////////////////////////////////

/////////////////////////////////////////////////////////////////////////////////////

/////////////////////////////////////////////////////////////////////////////////////

/////////////////////////////////////////////////////////////////////////////////////

/////////////////////////////////////////////////////////////////////////////////////

/////////////////////////////////////////////////////////////////////////////////////

/////////////////////////////////////////////////////////////////////////////////////

/////////////////////////////////////////////////////////////////////////////////////

/////////////////////////////////////////////////////////////////////////////////////

/////////////////////////////////////////////////////////////////////////////////////

/////////////////////////////////////////////////////////////////////////////////////

/////////////////////////////////////////////////////////////////////////////////////

/////////////////////////////////////////////////////////////////////////////////////

/////////////////////////////////////////////////////////////////////////////////////

/////////////////////////////////////////////////////////////////////////////////////

/////////////////////////////////////////////////////////////////////////////////////

/////////////////////////////////////////////////////////////////////////////////////

/////////////////////////////////////////////////////////////////////////////////////

/////////////////////////////////////////////////////////////////////////////////////

/////////////////////////////////////////////////////////////////////////////////////

/////////////////////////////////////////////////////////////////////////////////////

/////////////////////////////////////////////////////////////////////////////////////

/////////////////////////////////////////////////////////////////////////////////////

/////////////////////////////////////////////////////////////////////////////////////

#include "config.h"
#include "Fun_e2p.h"

#include "Fun_mqtt.h"
#include "Fun_wifi.h"
#include "Fun_operation.h"
#include "Fun_teaSeq.h"
#include "Fun_nfc.h"
#include "Fun_time.h"

#include "Ui_lcd.h"
/////////////////////////////////////////////////////////////////////////////////////
uint16_t usQFontStart;
uint8_t ucHourCur;
uint8_t ucMinCur;
uint8_t ucSecCur;
/////////////////////////////////////////////////////////////////////////////////////
Fun_e2p e2p_info(0x3FB);
// Fun_e2p e2p_data(0x3FA);
Fun_e2p e2p_network(0x3F9);
Fun_e2p e2p_data(0x3F8); // 01/11/2023
/////////////////////////////////////////////////////////////////////////////////////
/////////////////////////////////////////////////////////////////////////////////////
/////////////////////////////////////////////////////////////////////////////////////
/////////////////////////////////////////////////////////////////////////////////////
void reset_blank_nfc_uid();
/////////////////////////////////////////////////////////////////////////////////////
/////////////////////////////////////////////////////////////////////////////////////
/////////////////////////////////////////////////////////////////////////////////////
/////////////////////////////////////////////////////////////////////////////////////
/////////////////////////////////////////////////////////////////////////////////////
/////////////////////////////////////////////////////////////////////////////////////
/////////////////////////////////////////////////////////////////////////////////////
Fun_e2p::Fun_e2p(uint32_t sector)
{
    EEPROM = new EEPROMClass(sector);
}
/////////////////////////////////////////////////////////////////////////////////////
Fun_e2p::~Fun_e2p()
{
}
/////////////////////////////////////////////////////////////////////////////////////
void Fun_e2p::begin(uint32_t addr)
{
    EEPROM->begin(addr);
}
/////////////////////////////////////////////////////////////////////////////////////
bool Fun_e2p::commit()
{
    return EEPROM->commit();

    // return true;
}
/////////////////////////////////////////////////////////////////////////////////////
uint8_t Fun_e2p::read(uint16_t usAddr)
{
    return EEPROM->read(usAddr);
}
/////////////////////////////////////////////////////////////////////////////////////
void Fun_e2p::write(uint16_t usAddr, uint8_t ucData)
{
    EEPROM->write(usAddr, ucData);
    delay(1);
}
/////////////////////////////////////////////////////////////////////////////////////
void Fun_e2p::write_16(uint16_t usAddr, uint16_t usData)
{
    delay(1);
    EEPROM->write(usAddr, (uint8_t)(usData >> 8));
    delay(1);
    EEPROM->write(usAddr + 1, (uint8_t)usData);
}
/////////////////////////////////////////////////////////////////////////////////////
uint16_t Fun_e2p::read_16(uint16_t usAddr)
{
    uint16_t usRv = 0;
    usRv = (uint16_t)(EEPROM->read(usAddr) << 8);
    usRv += (uint16_t)EEPROM->read(usAddr + 1);
    return (usRv);
}
/////////////////////////////////////////////////////////////////////////////////////
void Fun_e2p::write_32(uint16_t usAddr, uint32_t ulData)
{
    uint8_t i;
    for (i = 0; i < 4; i++)
    {
        delay(1);
        EEPROM->write(usAddr + i, (uint8_t)(ulData >> (8 * (3 - i))));
    }
}
/////////////////////////////////////////////////////////////////////////////////////
uint32_t Fun_e2p::read_32(uint16_t usAddr)
{
    uint32_t usRv = 0;
    uint32_t val;
    uint8_t i;
    for (i = 0; i < 4; i++)
    {
        val = (uint32_t)EEPROM->read(usAddr + i);
        usRv += (uint32_t)(val << (8 * (3 - i)));
    }
    return (usRv);
}
/////////////////////////////////////////////////////////////////////////////////////
void Fun_e2p::write_buff(uint16_t usAddr, char *buff, uint8_t ucLen)
{
    uint16_t i = 0;
    for (i = usAddr; i < usAddr + ucLen; i++)
    {
        delay(1);
        EEPROM->write(i, buff[i - usAddr]);
    }
}
/////////////////////////////////////////////////////////////////////////////////////
void Fun_e2p::read_buff(uint16_t usAddr, char *buff, uint8_t ucLen)
{
    uint16_t i = 0;
    for (i = usAddr; i < usAddr + ucLen; i++)
        buff[i - usAddr] = EEPROM->read(i);
}
/////////////////////////////////////////////////////////////////////////////////////
void Fun_e2p::StringToE2P(uint16_t usAddr, uint8_t ucLen, String stStr)
{
    char cTmp[ucLen];

    stStr.toCharArray(cTmp, ucLen + 1);
    write_buff(usAddr, cTmp, ucLen);
}
/////////////////////////////////////////////////////////////////////////////////////
String Fun_e2p::E2PtoString(uint16_t usAddr, uint8_t ucLen)
{
    char cTmp[ucLen];
    String stString;

    read_buff(usAddr, cTmp, ucLen);

    stString = (char *)cTmp;

    // Erase grabage data(I don't know why.. some data happen..
    if (stString.length() > ucLen)
        stString.remove(ucLen, stString.length() - ucLen);

    return (stString);
}
/////////////////////////////////////////////////////////////////////////////////////
uint8_t e2p_info_read_8(uint16_t usAddr)
{
    return e2p_info.read(usAddr);
}
/////////////////////////////////////////////////////////////////////////////////////
uint16_t e2p_info_read_16(uint16_t usAddr)
{
    return e2p_info.read_16(usAddr);
}
/////////////////////////////////////////////////////////////////////////////////////
uint32_t e2p_info_read_32(uint16_t usAddr)
{
    return e2p_info.read_32(usAddr);
}
/////////////////////////////////////////////////////////////////////////////////////
String e2p_info_E2PtoString(uint16_t usAddr, uint8_t ucLen)
{
    return e2p_info.E2PtoString(usAddr, ucLen);
}
/////////////////////////////////////////////////////////////////////////////////////
void e2p_info_write_8(uint16_t usAddr, uint8_t ucData)
{
    e2p_info.write(usAddr, ucData);
}
/////////////////////////////////////////////////////////////////////////////////////
void e2p_info_write_16(uint16_t usAddr, uint16_t ucData)
{
    e2p_info.write_16(usAddr, ucData);
}
/////////////////////////////////////////////////////////////////////////////////////
void e2p_info_write_32(uint16_t usAddr, uint32_t ucData)
{
    e2p_info.write_32(usAddr, ucData);
}
/////////////////////////////////////////////////////////////////////////////////////
void e2p_info_StringToE2P(uint16_t usAddr, uint8_t ucLen, String stStr)
{
    e2p_info.StringToE2P(usAddr, ucLen, stStr);
}
/////////////////////////////////////////////////////////////////////////////////////
/////////////////////////////////////////////////////////////////////////////////////
uint8_t e2p_data_read_8(uint16_t usAddr)
{
    return e2p_data.read(usAddr);
}
/////////////////////////////////////////////////////////////////////////////////////
uint16_t e2p_data_read_16(uint16_t usAddr)
{
    return e2p_data.read_16(usAddr);
}
/////////////////////////////////////////////////////////////////////////////////////
uint32_t e2p_data_read_32(uint16_t usAddr)
{
    return e2p_data.read_32(usAddr);
}
/////////////////////////////////////////////////////////////////////////////////////
void e2p_data_write_8(uint16_t usAddr, uint8_t ucData)
{
    e2p_data.write(usAddr, ucData);
}
/////////////////////////////////////////////////////////////////////////////////////
void e2p_data_write_16(uint16_t usAddr, uint16_t ucData)
{
    e2p_data.write_16(usAddr, ucData);
}
/////////////////////////////////////////////////////////////////////////////////////
void write_32(uint16_t usAddr, uint32_t ucData)
{
    e2p_data.write_32(usAddr, ucData);
}
/////////////////////////////////////////////////////////////////////////////////////
void init_e2p()
{
    e2p_info.begin(E2PE_ADR_BEGIN_INFO);
    delay(10);
    e2p_data.begin(E2PE_ADR_BEGIN_DATA);
    delay(10);
    e2p_network.begin(E2PE_ADR_BEGIN_NETWORK);
    delay(10);

    if (e2p_info.read(E2PE_ADR_INIT_INFO) != E2PE_INIT_CODE_INFO)
    {
        E2P_ResetE2p_info();
    }

    if (e2p_data.read(E2PE_ADR_INIT_DATA) != E2PE_INIT_CODE_DATA)
    {
        E2P_ResetE2p_data();
    }

    if (e2p_network.read(E2PE_ADR_INIT_NETWORK) != E2PE_INIT_CODE_NETWORK)
    {
        E2P_ResetE2p_network();
    }

    E2P_UpdateE2pVal();

    usQFontStart = e2p_data.read_16(E2PE_ADR_DATA_Q_FRONT);

    //////////////////////////////////////////
    //////////////////////////////////////////
    //////////////////////////////////////////
    //////////////////////////////////////////
}
/////////////////////////////////////////////////////////////////////////////////////
void E2P_ResetE2p_data()
{
#ifdef ESP_DEBUG_E2P
    Serial.printf("E2P_ResetE2p_data\r\n");
#endif

    e2p_data.write(E2PE_ADR_INIT_DATA, E2PE_INIT_CODE_DATA);

    e2p_data.write_32(E2PE_ADR_MC_DAPOT, 0);   // power ontime
    e2p_data.write_32(E2PE_ADR_MC_HANDLE, 0);  // handling time
    e2p_data.write_32(E2PE_ADR_MC_DAMRT, 0);   // motor runtime
    e2p_data.write_16(E2PE_ADR_MC_CT, 0);      // cycle time
    e2p_data.write_32(E2PE_ADR_MC_NUM_STI, 0); // sum of stitch
    e2p_data.write_32(E2PE_ADR_MC_NUM_TRI, 0); // sum of trim

    reset_production();

    e2p_data.commit_flag = true;

    debug.msg_debug.concat(" --/ rst_data");
    debug.send_debug = true;
}
/////////////////////////////////////////////////////////////////////////////////////
void E2P_ResetE2p_network()
{
#ifdef ESP_DEBUG_E2P
    Serial.printf("E2P_ResetE2p_network\r\n");
#endif

    e2p_network.write(E2PE_ADR_INIT_NETWORK, E2PE_INIT_CODE_NETWORK);
    e2p_network.write(E2PE_ADR_NON_SEW_MC, 0); // default sewing mc

    // network default factory
    e2p_network.StringToE2P(E2PE_ADR_SSID, E2PE_LEN_SSID, String("SVG RND"));
    e2p_network.StringToE2P(E2PE_ADR_PASS, E2PE_LEN_PASS, String("svgims1234"));
    e2p_network.StringToE2P(E2PE_ADR_SVR_ADDR, E2PE_LEN_SVR_ADDR, String("192.168.1.101"));
    e2p_network.write_16(E2PE_ADR_SVR_PORT, 80);
    // // pkgb
    // e2p_network.StringToE2P(E2PE_ADR_SSID, E2PE_LEN_SSID, String("PK_MACHINE"));
    // e2p_network.StringToE2P(E2PE_ADR_PASS, E2PE_LEN_PASS, String("pkid_2017"));
    // e2p_network.StringToE2P(E2PE_ADR_SVR_ADDR, E2PE_LEN_SVR_ADDR, String("10.109.10.251"));
    // e2p_network.write_16(E2PE_ADR_SVR_PORT, 80);
    // // pksb
    // e2p_network.StringToE2P(E2PE_ADR_SSID, E2PE_LEN_SSID, String("PK_MACHINE"));
    // e2p_network.StringToE2P(E2PE_ADR_PASS, E2PE_LEN_PASS, String("pkid_2017"));
    // e2p_network.StringToE2P(E2PE_ADR_SVR_ADDR, E2PE_LEN_SVR_ADDR, String("10.108.50.3"));
    // e2p_network.write_16(E2PE_ADR_SVR_PORT, 84);
    // // pkbt
    // e2p_network.StringToE2P(E2PE_ADR_SSID, E2PE_LEN_SSID, String("PKMachine"));
    // e2p_network.StringToE2P(E2PE_ADR_PASS, E2PE_LEN_PASS, String("PKIOT2018"));
    // e2p_network.StringToE2P(E2PE_ADR_SVR_ADDR, E2PE_LEN_SVR_ADDR, String("10.104.10.40"));
    // e2p_network.write_16(E2PE_ADR_SVR_PORT, 80);
    // // PI3
    // e2p_network.StringToE2P(E2PE_ADR_SSID, E2PE_LEN_SSID, String("IOT-XB"));
    // e2p_network.StringToE2P(E2PE_ADR_PASS, E2PE_LEN_PASS, String("P@@nginvina0#@!"));
    // e2p_network.StringToE2P(E2PE_ADR_SVR_ADDR, E2PE_LEN_SVR_ADDR, String("192.168.2.240"));
    // e2p_network.write_16(E2PE_ADR_SVR_PORT, 80);
    // // pks3
    // e2p_network.StringToE2P(E2PE_ADR_SSID, E2PE_LEN_SSID, String("PKMachine"));
    // e2p_network.StringToE2P(E2PE_ADR_PASS, E2PE_LEN_PASS, String("PKIOT2018"));
    // e2p_network.StringToE2P(E2PE_ADR_SVR_ADDR, E2PE_LEN_SVR_ADDR, String("10.103.10.40"));
    // e2p_network.write_16(E2PE_ADR_SVR_PORT, 80);

    e2p_network.commit_flag = true;

    debug.msg_debug.concat(" --/ rst_network");
    debug.send_debug = true;
}
/////////////////////////////////////////////////////////////////////////////////////
void E2P_ResetE2p_info()
{
#ifdef ESP_DEBUG_E2P
    Serial.printf("E2P_ResetE2p_info\r\n");
#endif

    e2p_info.write(E2PE_ADR_INIT_INFO, E2PE_INIT_CODE_INFO);

    e2p_info.write(E2PE_ADR_INDX_PLAN, 0);   // current index  plan
    e2p_info.write(E2PE_ADR_DAI_OUT_RST, 1); // daily output reset, default 1

    e2p_info.write(E2PE_ADR_LEN_BLA_NFC, 0);     // nfc blank uid nfc (classic 4, mifare ultralight 7)
    e2p_info.write(E2PE_ADR_SEN_BLA_NFC, 0);     // flag send blank uid nfc to server
    e2p_info.write(E2PE_ADR_INOUT_MODE, 0);      // disable in/out iot mode
    e2p_info.write(E2PE_ADR_IGNORE_SEN0_TEA, 0); // disable ignore sen0 teaching sequence
    e2p_info.write(E2PE_ADR_DIR_ANDON_MC, 0);    // disable dir. andon mc

    e2p_info.write_16(E2PE_ADR_OUT_SCALE, 1);                               // output scale
    e2p_info.write_16(E2PE_ADR_BREAK_MODE, MOD_BRK_OFF);                    // current andon mode
    e2p_info.write_16(E2PE_ADR_TEA_DLY_SEN0, Fun_teaSeq::TEA_DEF_DLY_SEN0); // current andon mode

    // location
    e2p_info.write_16(E2PE_ADR_POSITION, 0);
    e2p_info.StringToE2P(E2PE_ADR_FACTORY, E2PE_LEN_FACTORY, String("-"));
    e2p_info.StringToE2P(E2PE_ADR_LINE, E2PE_LEN_LINE, String("-"));
    // machine
    e2p_info.StringToE2P(E2PE_ADR_MC_ID, E2PE_LEN_MC_ID, String("-"));
    e2p_info.StringToE2P(E2PE_ADR_MC_SUPY, E2PE_LEN_MC_SUPY, String("-"));
    // worker
    e2p_info.StringToE2P(E2PE_ADR_WRK_ID, E2PE_LEN_WRK_ID, String("-"));
    e2p_info.StringToE2P(E2PE_ADR_WRK_NA, E2PE_LEN_WRK_NA, String("-"));
    e2p_info.StringToE2P(E2PE_ADR_WRK_SKILL, E2PE_LEN_WRK_SKILL, String("-"));
    // process
    e2p_info.StringToE2P(E2PE_ADR_STYLE, E2PE_LEN_STYLE, String("-"));
    e2p_info.StringToE2P(E2PE_ADR_PROC, E2PE_LEN_PROC, String("-"));
    e2p_info.StringToE2P(E2PE_ADR_PROC_SEQ, E2PE_LEN_PROC_SEQ, String("-"));

    rst_allTeachingSequence(); // reset teaching

    e2p_info.commit_flag = true;

    debug.msg_debug.concat(" --/ rst_info");
    debug.send_debug = true;
}
/////////////////////////////////////////////////////////////////////////////////////
void E2P_UpdateE2pVal()
{
    //////////////////////////////////////////
    get_uid_blank();
    check_uid_blank_problem();
    //////////////////////////////////////////
    oper.current_idx_plan = e2p_info.read(E2PE_ADR_INDX_PLAN);
    if (oper.current_idx_plan >= LEN_JSON_OBJECT_PLAN)
    {
        oper.current_idx_plan = 0;
        e2p_info.write(E2PE_ADR_INDX_PLAN, oper.current_idx_plan);
    }

    //
    oper.daily_product_reset = e2p_info.read(E2PE_ADR_DAI_OUT_RST);
    oper.scale = e2p_info.read_16(E2PE_ADR_OUT_SCALE);

    // location
    oper.factory = e2p_info.E2PtoString(E2PE_ADR_FACTORY, E2PE_LEN_FACTORY);
    oper.line = e2p_info.E2PtoString(E2PE_ADR_LINE, E2PE_LEN_LINE);
    oper.position = e2p_info.read_16(E2PE_ADR_POSITION);
    // machine
    oper.machine_id = e2p_info.E2PtoString(E2PE_ADR_MC_ID, E2PE_LEN_MC_ID);
    // worker
    oper.worker_id = e2p_info.E2PtoString(E2PE_ADR_WRK_ID, E2PE_LEN_WRK_ID);
    oper.worker_name = e2p_info.E2PtoString(E2PE_ADR_WRK_NA, E2PE_LEN_WRK_NA);
    oper.worker_skill = e2p_info.E2PtoString(E2PE_ADR_WRK_SKILL, E2PE_LEN_WRK_SKILL);
    // process
    oper.style = e2p_info.E2PtoString(E2PE_ADR_STYLE, E2PE_LEN_STYLE);
    oper.process = e2p_info.E2PtoString(E2PE_ADR_PROC, E2PE_LEN_PROC);

    // teaching
    tea.delay_sen0 = e2p_info.read_16(E2PE_ADR_TEA_DLY_SEN0);
    if (tea.delay_sen0 > Fun_teaSeq::TEA_MAX_DLY_SEN0) // more than 2000ms
    {
        tea.delay_sen0 = Fun_teaSeq::TEA_DEF_DLY_SEN0; // 10ms
        e2p_info.write_16(E2PE_ADR_TEA_DLY_SEN0, tea.delay_sen0);
    }
    read_allTeachingSequence();

    // in/out iot mode
    if (e2p_info.read(E2PE_ADR_INOUT_MODE) == 1)
        oper.in_out_iot_mode_enable = true;
    else
        oper.in_out_iot_mode_enable = false;

    oper.in_out_input_mode = 1;

    // ignore sen0 teaching sequence
    if (e2p_info.read(E2PE_ADR_IGNORE_SEN0_TEA) == 1)
        tea.ignore_sen0_teaseq = true;
    else
        tea.ignore_sen0_teaseq = false;

    // dir. andon mc mode
    if (e2p_info.read(E2PE_ADR_DIR_ANDON_MC) == 1)
        oper.dir_andon_mc_mode = true;
    else
        oper.dir_andon_mc_mode = false;

    //////////////////////////////////////////
    // page data
    // product data
    oper.output = e2p_data.read_32(oper.list_addr_output[oper.current_idx_plan]);
    oper.defect = e2p_data.read_32(oper.list_addr_output[oper.current_idx_plan] + E2PE_LEN_OUTPUT);
    oper.target = e2p_data.read_32(oper.list_addr_output[oper.current_idx_plan] + E2PE_LEN_OUTPUT + E2PE_LEN_DEFECT);
    // machine time
    oper.power_ontime = e2p_data.read_32(E2PE_ADR_MC_DAPOT); // power on time
    if (oper.power_ontime > 90000)
    {
        // reset m/c time
        oper.power_ontime = 0;
        oper.motor_runtime = 0;
        oper.handling_time = 0;
        oper.cycle_time = 0;
        oper.sumof_stitch = 0;
        oper.sumof_trim = 0;

        e2p_data.write_32(E2PE_ADR_MC_DAPOT, oper.power_ontime);
        e2p_data.write_32(E2PE_ADR_MC_DAMRT, oper.motor_runtime);
        e2p_data.write_32(E2PE_ADR_MC_HANDLE, oper.handling_time);
        e2p_data.write_32(E2PE_ADR_MC_CT, oper.cycle_time);
        e2p_data.write_32(E2PE_ADR_MC_NUM_STI, oper.sumof_stitch);
        e2p_data.write_32(E2PE_ADR_MC_NUM_TRI, oper.sumof_trim);
    }

    oper.power_time_line = oper.power_ontime;
    oper.motor_runtime = e2p_data.read_32(E2PE_ADR_MC_DAMRT);  // motor runtime
    oper.handling_time = e2p_data.read_32(E2PE_ADR_MC_HANDLE); // handling time
    oper.cycle_time = e2p_data.read_32(E2PE_ADR_MC_CT);        // cycle time
    oper.sumof_stitch = e2p_data.read_32(E2PE_ADR_MC_NUM_STI); // number of stitch
    oper.sumof_trim = e2p_data.read_32(E2PE_ADR_MC_NUM_TRI);   // number of trim

    //////////////////////////////////////////
    // page network
    // network
    wifi.sSsid = e2p_network.E2PtoString(E2PE_ADR_SSID, E2PE_LEN_SSID);
    wifi.sPassword = e2p_network.E2PtoString(E2PE_ADR_PASS, E2PE_LEN_PASS);
    mqtt.sSvrAddr = e2p_network.E2PtoString(E2PE_ADR_SVR_ADDR, E2PE_LEN_SVR_ADDR);
    mqtt.usSvrPort = e2p_network.read_16(E2PE_ADR_SVR_PORT);
    // for cal sewing or non-sewing mc
    oper.ucNonSewingMc = e2p_network.read(E2PE_ADR_NON_SEW_MC);
    if (oper.ucNonSewingMc > 1)
    {
        oper.ucNonSewingMc = 0; // sewing mc
        e2p_network.write(E2PE_ADR_NON_SEW_MC, oper.ucNonSewingMc);
    }
}
/////////////////////////////////////////////////////////////////////////////////////
void updateTimeEEPROM()
{
    uint8_t ucHour, ucMin, ucSec;
    uint16_t usQRear, usQfront, usQfrontAddr;
    uint32_t ulDelta;

    usQfront = e2p_data.read_16(E2PE_ADR_DATA_Q_FRONT);
    usQRear = usQFontStart;

    if (usQfront == usQRear)
        return;

    ti.getSysTime();
    for (int i = usQRear; i < usQfront; i++)
    {
        usQfrontAddr = i * E2PE_LEN_Q_DATA;

        // if (e2p_data.read(usQfrontAddr + Q_BUF_IDX_YEAR) > 20)
        //     continue;

        ucHour = e2p_data.read(usQfrontAddr + Q_BUF_IDX_HOUR);
        ucMin = e2p_data.read(usQfrontAddr + Q_BUF_IDX_MIN);
        ucSec = e2p_data.read(usQfrontAddr + Q_BUF_IDX_SEC);

        ulDelta = (ucHourCur * 3600 + ucMinCur * 60 + ucSecCur) - (ucHour * 3600 + ucMin * 60 + ucSec);
        ucHour = ulDelta / 3600;
        ucMin = (ulDelta - ucHour * 3600) / 60;
        ucSec = ulDelta - ucHour * 3600 - ucMin * 60;

        if (ti.sysTime.tm_hour < ucHour) // calcute hour
            ucHour = ti.sysTime.tm_hour + 24 - ucHour;
        else
            ucHour = ti.sysTime.tm_hour - ucHour;

        if (ti.sysTime.tm_min < ucMin)
        { // calcute min
            ucHour--;
            ucMin = ti.sysTime.tm_min + 60 - ucMin;
        }
        else
            ucMin = ti.sysTime.tm_min - ucMin;
        if (ti.sysTime.tm_sec < ucSec)
        { // calcute second
            if (ucMin == 0)
            {
                ucHour--;
                ucMin = 59;
            }
            else
                ucMin--;
            ucSec = ti.sysTime.tm_sec + 60 - ucSec;
        }
        else
            ucSec = ti.sysTime.tm_sec - ucSec;

        ucHour = ucHour % 24;
        ucMin = ucMin % 60;
        ucSec = ucSec % 60;

        e2p_data.write(usQfrontAddr + Q_BUF_IDX_YEAR, ti.sysTime.tm_year - 2000);
        e2p_data.write(usQfrontAddr + Q_BUF_IDX_MON, ti.sysTime.tm_mon);
        e2p_data.write(usQfrontAddr + Q_BUF_IDX_DAY, ti.sysTime.tm_mday);
        e2p_data.write(usQfrontAddr + Q_BUF_IDX_HOUR, ucHour);
        e2p_data.write(usQfrontAddr + Q_BUF_IDX_MIN, ucMin);
        e2p_data.write(usQfrontAddr + Q_BUF_IDX_SEC, ucSec);
    }
    e2p_data.commit_flag = true;
}
/////////////////////////////////////////////////////////////////////////////////////
void resetDataWhenNewDay(bool timer)
{
    e2p_info.write(E2PE_ADR_DAY_RESET, ti.sysTime.tm_mday); // save day old
    e2p_info.write(E2PE_ADR_MON_RESET, ti.sysTime.tm_mon);  // save mon old

    if (oper.daily_product_reset)
    {
        if (timer)
        {
            reset_production();

            debug.msg_debug.concat(" --/ rst_output_timer");
            debug.send_debug = true;
        }
        else
        {
            e2p_data.write_16(E2PE_ADR_DATA_Q_REAR, usQFontStart); // QR = QF <- QF at turn on
            updateOutputValueEEPROM();                             // update or reset Output
        }
    }

    reset_mc_time();       // reset mc time
    reset_blank_nfc_uid(); // reset blank nfc uid

    debug.msg_debug.concat(" --/ rst_mctime_newday");
    debug.send_debug = true;

    e2p_info.commit_flag = true;
    e2p_data.commit_flag = true;
}
/////////////////////////////////////////////////////////////////////////////////////
void updateOutputValueEEPROM()
{
    uint16_t usQRear, usQfront, usQAddr;
    uint32_t usDataOutput;
    uint32_t usDataDefect;
    uint32_t ulData;

    usQfront = e2p_data.read_16(E2PE_ADR_DATA_Q_FRONT);
    usQRear = e2p_data.read_16(E2PE_ADR_DATA_Q_REAR);

    if (usQfront == usQRear)
    {
        reset_production();

        debug.msg_debug.concat(" --/ rst_output_1111");
        debug.send_debug = true;

        return;
    }

    usDataOutput = 0;
    usDataDefect = 0;
    ulData = 0;
    for (int i = usQRear; i < usQfront; i++)
    {
        usQAddr = i * E2PE_LEN_Q_DATA;
        if (e2p_data.read(usQAddr + Q_BUF_IDX_TYPE) == Q_TYPE_OUTPUT)
        {
            usDataOutput++;
            ulData = usDataOutput;
        }
        else if (e2p_data.read(usQAddr + Q_BUF_IDX_TYPE) == Q_TYPE_DEFECT)
        {
            usDataDefect++;
            ulData = usDataDefect;
        }
        // update data
        for (int i = 0; i < LEN_BYTE_PRODUCT_DATA; i++)
            e2p_data.write(usQAddr + Q_BUF_IDX_DATA + i, (uint8_t)(ulData >> (8 * (LEN_BYTE_PRODUCT_DATA - 1 - i))));

        // update process id
        e2p_data.write(usQAddr + Q_BUF_IDX_CUR_PLAN, oper.current_idx_plan);
    }

    oper.output = usDataOutput;
    e2p_data.write_32(oper.list_addr_output[oper.current_idx_plan], oper.output);
    oper.defect = usDataDefect;
    e2p_data.write_32(oper.list_addr_output[oper.current_idx_plan] + E2PE_LEN_OUTPUT, oper.defect);

    for (uint8_t i = 0; i < LEN_JSON_OBJECT_PLAN; i++)
    {
        if (i == oper.current_idx_plan)
            continue;                                                                       // if == process id current, not reset = 0
        e2p_data.write_16(oper.list_addr_output[i], 0);                                     // output = 0
        e2p_data.write_16(oper.list_addr_output[i] + E2PE_LEN_OUTPUT, 0);                   // defect = 0
        e2p_data.write_16(oper.list_addr_output[i] + E2PE_LEN_OUTPUT + E2PE_LEN_DEFECT, 0); // target = 0
    }

    e2p_data.commit_flag = true;

    debug.msg_debug.concat(" --/ rst_output_2222");
    debug.send_debug = true;
}
/////////////////////////////////////////////////////////////////////////////////////
void chkAndonMode()
{
    uint16_t usModeEEP = e2p_info.read_16(E2PE_ADR_BREAK_MODE);
    if (usModeEEP != MOD_BRK_OFF)
    {
        for (uint8_t i = 0; i < LEN_BREAK_REASON; i++)
        {
            uint16_t usMode = MOD_BRK_MACHINE << (i * 4);
            if (usMode == usModeEEP)
            {
                lcd.list_index = i;
                lcd.disp_andon_sub();
                break;
            }
        }
    }

    oper.bSendAndon = true;
}
/////////////////////////////////////////////////////////////////////////////////////
void get_uid_blank()
{
    // send blank uid nfc
    nfc.bSendUidNfcBlank2Svr = e2p_info.read(E2PE_ADR_SEN_BLA_NFC);
    nfc.ucLenUidBlank = e2p_info.read(E2PE_ADR_LEN_BLA_NFC);

    if (nfc.ucLenUidBlank <= 20 && nfc.ucLenUidBlank != 0)
        nfc.sUidBlank = e2p_info.E2PtoString(E2PE_ADR_NFC_UID_STR, nfc.ucLenUidBlank);
    else
        nfc.sUidBlank = "";

    // add
    char cTmp[nfc.ucLenUidBlank];
    e2p_info.read_buff(E2PE_ADR_NFC_UID_STR, cTmp, nfc.ucLenUidBlank);
    //

    // debug.msg_debug.concat(" --/ read_nfc_uid, ");
    // debug.msg_debug.concat("len: ");
    // debug.msg_debug.concat(nfc.ucLenUidBlank);
    // debug.msg_debug.concat(", ");
    // debug.msg_debug.concat("uid: ");
    // debug.msg_debug.concat(nfc.sUidBlank);

    // debug.send_debug = true;
}
/////////////////////////////////////////////////////////////////////////////////////
extern uint8_t ucCntUidRs;
void check_uid_blank_problem()
{
    if (nfc.ucLenUidBlank == 0)
        return;

    bool ret = false;
    for (uint8_t i = 0; i < nfc.ucLenUidBlank; i++)
    {
        if (nfc.sUidBlank.charAt(i) < 0x30)
            ret = true;
        if (i != 0 && i % 3 == 2 && nfc.sUidBlank.charAt(i) != ':')
            ret = true;

        // fix wrong character
        if (nfc.sUidBlank.charAt(i) < 0x30)
        {
            if (nfc.sUidBlank.charAt(i) < 0x20)
                nfc.sUidBlank.setCharAt(i, nfc.sUidBlank.charAt(i) + 0x20);
            else
                nfc.sUidBlank.setCharAt(i, nfc.sUidBlank.charAt(i) + 0x10);
        }

        if (i != 0 && i % 3 == 2 && nfc.sUidBlank.charAt(i) != ':')
            nfc.sUidBlank.setCharAt(i, ':');
    }

    if (ret)
    {
        debug.msg_debug.concat(" --/ check uid blank false => read again ");
        debug.msg_debug.concat(ucCntUidRs);
        debug.msg_debug.concat(" --/ aftern fix:  ");
        debug.msg_debug.concat("uid: ");
        debug.msg_debug.concat(nfc.sUidBlank);
        debug.send_debug = true;

        nfc.get_uid_blank_again = true;

        // write again
        e2p_info.StringToE2P(E2PE_ADR_NFC_UID_STR, nfc.ucLenUidBlank, nfc.sUidBlank);
        e2p_info.commit_flag = true;
    }
}
/////////////////////////////////////////////////////////////////////////////////////
void reset_blank_nfc_uid()
{
    nfc.sUidBlank = "";
    nfc.ucLenUidBlank = 0;

    e2p_info.write(E2PE_ADR_LEN_BLA_NFC, nfc.ucLenUidBlank);

    debug.msg_debug.concat(" --/ rst_blank_nfc_uid");
    debug.send_debug = true;
}
/////////////////////////////////////////////////////////////////////////////////////

/////////////////////////////////////////////////////////////////////////////////////

/////////////////////////////////////////////////////////////////////////////////////

/////////////////////////////////////////////////////////////////////////////////////

/////////////////////////////////////////////////////////////////////////////////////

/////////////////////////////////////////////////////////////////////////////////////

/////////////////////////////////////////////////////////////////////////////////////

/////////////////////////////////////////////////////////////////////////////////////

/////////////////////////////////////////////////////////////////////////////////////

/////////////////////////////////////////////////////////////////////////////////////

/////////////////////////////////////////////////////////////////////////////////////

/////////////////////////////////////////////////////////////////////////////////////

/////////////////////////////////////////////////////////////////////////////////////

/////////////////////////////////////////////////////////////////////////////////////

/////////////////////////////////////////////////////////////////////////////////////

/////////////////////////////////////////////////////////////////////////////////////

/////////////////////////////////////////////////////////////////////////////////////

/////////////////////////////////////////////////////////////////////////////////////

/////////////////////////////////////////////////////////////////////////////////////

/////////////////////////////////////////////////////////////////////////////////////

/////////////////////////////////////////////////////////////////////////////////////

/////////////////////////////////////////////////////////////////////////////////////

/////////////////////////////////////////////////////////////////////////////////////

/////////////////////////////////////////////////////////////////////////////////////

/////////////////////////////////////////////////////////////////////////////////////

/////////////////////////////////////////////////////////////////////////////////////

/////////////////////////////////////////////////////////////////////////////////////

/////////////////////////////////////////////////////////////////////////////////////

/////////////////////////////////////////////////////////////////////////////////////

/////////////////////////////////////////////////////////////////////////////////////

/////////////////////////////////////////////////////////////////////////////////////

/////////////////////////////////////////////////////////////////////////////////////

/////////////////////////////////////////////////////////////////////////////////////

/////////////////////////////////////////////////////////////////////////////////////

/////////////////////////////////////////////////////////////////////////////////////

/////////////////////////////////////////////////////////////////////////////////////

/////////////////////////////////////////////////////////////////////////////////////

/////////////////////////////////////////////////////////////////////////////////////

/////////////////////////////////////////////////////////////////////////////////////

/////////////////////////////////////////////////////////////////////////////////////

/////////////////////////////////////////////////////////////////////////////////////

/////////////////////////////////////////////////////////////////////////////////////

/////////////////////////////////////////////////////////////////////////////////////

/////////////////////////////////////////////////////////////////////////////////////

/////////////////////////////////////////////////////////////////////////////////////

/////////////////////////////////////////////////////////////////////////////////////

/////////////////////////////////////////////////////////////////////////////////////

/////////////////////////////////////////////////////////////////////////////////////

/////////////////////////////////////////////////////////////////////////////////////

/////////////////////////////////////////////////////////////////////////////////////

/////////////////////////////////////////////////////////////////////////////////////

/////////////////////////////////////////////////////////////////////////////////////

/////////////////////////////////////////////////////////////////////////////////////

/////////////////////////////////////////////////////////////////////////////////////

/////////////////////////////////////////////////////////////////////////////////////

/////////////////////////////////////////////////////////////////////////////////////

/////////////////////////////////////////////////////////////////////////////////////

/////////////////////////////////////////////////////////////////////////////////////

/////////////////////////////////////////////////////////////////////////////////////

/////////////////////////////////////////////////////////////////////////////////////

/////////////////////////////////////////////////////////////////////////////////////

/////////////////////////////////////////////////////////////////////////////////////

/////////////////////////////////////////////////////////////////////////////////////

/////////////////////////////////////////////////////////////////////////////////////

/////////////////////////////////////////////////////////////////////////////////////

/////////////////////////////////////////////////////////////////////////////////////

/////////////////////////////////////////////////////////////////////////////////////

/////////////////////////////////////////////////////////////////////////////////////

/////////////////////////////////////////////////////////////////////////////////////

/////////////////////////////////////////////////////////////////////////////////////

/////////////////////////////////////////////////////////////////////////////////////

/////////////////////////////////////////////////////////////////////////////////////

/////////////////////////////////////////////////////////////////////////////////////

/////////////////////////////////////////////////////////////////////////////////////

/////////////////////////////////////////////////////////////////////////////////////

/////////////////////////////////////////////////////////////////////////////////////

/////////////////////////////////////////////////////////////////////////////////////

/////////////////////////////////////////////////////////////////////////////////////

/////////////////////////////////////////////////////////////////////////////////////

/////////////////////////////////////////////////////////////////////////////////////

/////////////////////////////////////////////////////////////////////////////////////

/////////////////////////////////////////////////////////////////////////////////////

/////////////////////////////////////////////////////////////////////////////////////

/////////////////////////////////////////////////////////////////////////////////////

/////////////////////////////////////////////////////////////////////////////////////

/////////////////////////////////////////////////////////////////////////////////////

/////////////////////////////////////////////////////////////////////////////////////

/////////////////////////////////////////////////////////////////////////////////////

/////////////////////////////////////////////////////////////////////////////////////

/////////////////////////////////////////////////////////////////////////////////////

/////////////////////////////////////////////////////////////////////////////////////

/////////////////////////////////////////////////////////////////////////////////////

/////////////////////////////////////////////////////////////////////////////////////

/////////////////////////////////////////////////////////////////////////////////////

/////////////////////////////////////////////////////////////////////////////////////

/////////////////////////////////////////////////////////////////////////////////////

/////////////////////////////////////////////////////////////////////////////////////

/////////////////////////////////////////////////////////////////////////////////////

/////////////////////////////////////////////////////////////////////////////////////

/////////////////////////////////////////////////////////////////////////////////////

/////////////////////////////////////////////////////////////////////////////////////

/////////////////////////////////////////////////////////////////////////////////////

/////////////////////////////////////////////////////////////////////////////////////

/////////////////////////////////////////////////////////////////////////////////////

/////////////////////////////////////////////////////////////////////////////////////

/////////////////////////////////////////////////////////////////////////////////////

/////////////////////////////////////////////////////////////////////////////////////

/////////////////////////////////////////////////////////////////////////////////////

/////////////////////////////////////////////////////////////////////////////////////

/////////////////////////////////////////////////////////////////////////////////////

/////////////////////////////////////////////////////////////////////////////////////

/////////////////////////////////////////////////////////////////////////////////////

/////////////////////////////////////////////////////////////////////////////////////

/////////////////////////////////////////////////////////////////////////////////////

/////////////////////////////////////////////////////////////////////////////////////

/////////////////////////////////////////////////////////////////////////////////////

/////////////////////////////////////////////////////////////////////////////////////

/////////////////////////////////////////////////////////////////////////////////////

/////////////////////////////////////////////////////////////////////////////////////

/////////////////////////////////////////////////////////////////////////////////////

/////////////////////////////////////////////////////////////////////////////////////

/////////////////////////////////////////////////////////////////////////////////////

/////////////////////////////////////////////////////////////////////////////////////

/////////////////////////////////////////////////////////////////////////////////////

/////////////////////////////////////////////////////////////////////////////////////

/////////////////////////////////////////////////////////////////////////////////////

/////////////////////////////////////////////////////////////////////////////////////

/////////////////////////////////////////////////////////////////////////////////////

/////////////////////////////////////////////////////////////////////////////////////

/////////////////////////////////////////////////////////////////////////////////////

/////////////////////////////////////////////////////////////////////////////////////

/////////////////////////////////////////////////////////////////////////////////////

/////////////////////////////////////////////////////////////////////////////////////

/////////////////////////////////////////////////////////////////////////////////////

/////////////////////////////////////////////////////////////////////////////////////

/////////////////////////////////////////////////////////////////////////////////////

/////////////////////////////////////////////////////////////////////////////////////

/////////////////////////////////////////////////////////////////////////////////////

/////////////////////////////////////////////////////////////////////////////////////

/////////////////////////////////////////////////////////////////////////////////////

/////////////////////////////////////////////////////////////////////////////////////

/////////////////////////////////////////////////////////////////////////////////////

/////////////////////////////////////////////////////////////////////////////////////

/////////////////////////////////////////////////////////////////////////////////////

/////////////////////////////////////////////////////////////////////////////////////

/////////////////////////////////////////////////////////////////////////////////////

/////////////////////////////////////////////////////////////////////////////////////

/////////////////////////////////////////////////////////////////////////////////////

/////////////////////////////////////////////////////////////////////////////////////

/////////////////////////////////////////////////////////////////////////////////////

/////////////////////////////////////////////////////////////////////////////////////

/////////////////////////////////////////////////////////////////////////////////////

/////////////////////////////////////////////////////////////////////////////////////

/////////////////////////////////////////////////////////////////////////////////////

/////////////////////////////////////////////////////////////////////////////////////

/////////////////////////////////////////////////////////////////////////////////////

/////////////////////////////////////////////////////////////////////////////////////

/////////////////////////////////////////////////////////////////////////////////////

/////////////////////////////////////////////////////////////////////////////////////

/////////////////////////////////////////////////////////////////////////////////////

/////////////////////////////////////////////////////////////////////////////////////

/////////////////////////////////////////////////////////////////////////////////////

/////////////////////////////////////////////////////////////////////////////////////

/////////////////////////////////////////////////////////////////////////////////////

/////////////////////////////////////////////////////////////////////////////////////

/////////////////////////////////////////////////////////////////////////////////////

/////////////////////////////////////////////////////////////////////////////////////

/////////////////////////////////////////////////////////////////////////////////////

/////////////////////////////////////////////////////////////////////////////////////

/////////////////////////////////////////////////////////////////////////////////////